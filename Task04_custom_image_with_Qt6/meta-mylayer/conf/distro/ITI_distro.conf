## Task04_custom_image_with_Qt6/meta-mylayer/conf/distro/ITI_distro.conf
```bitbake
require conf/distro/poky.conf

DISTRO = "ITI_distro"
DISTRO_NAME = "ITI_distro (Abdelfattah Reference Distro)"
TARGET_VENDOR = "-rpi3b"

DISTRO_FEATURES:append = " systemd usrmerge wifi opengl dbus"

VIRTUAL-RUNTIME_init_manager = "systemd"
VIRTUAL-RUNTIME_initscripts = "systemd-compat-units"
DISTRO_FEATURES_BACKFILL_CONSIDERED = " sysvinit"
```

## Task04_custom_image_with_Qt6/meta-mylayer/conf/layer.conf
```bitbake
BBPATH .= ":${LAYERDIR}"
BBFILES += "${LAYERDIR}/recipes-*/*/*.bb ${LAYERDIR}/recipes-*/*/*.bbappend"
BBFILE_COLLECTIONS += "my-layer"
BBFILE_PATTERN_my-layer = "^${LAYERDIR}/"
LAYER_CONF_VERSION = "8"
LAYERSERIES_COMPAT_my-layer = "scarthgap"
```

## Task04_custom_image_with_Qt6/meta-rpi-3b-plus/conf/layer.conf
```bitbake
# We have a conf and classes directory, add to BBPATH
BBPATH .= ":${LAYERDIR}"

# We have recipes-* directories, add to BBFILES
BBFILES += "${LAYERDIR}/recipes-*/*/*.bb \
            ${LAYERDIR}/recipes-*/*/*.bbappend"

BBFILE_COLLECTIONS += "meta-rpi-3b-plus-BSP"
BBFILE_PATTERN_meta-rpi-3b-plus-BSP = "^${LAYERDIR}/"
BBFILE_PRIORITY_meta-rpi-3b-plus-BSP = "6"

LAYERDEPENDS_meta-rpi-3b-plus-BSP = "core"
LAYERSERIES_COMPAT_meta-rpi-3b-plus-BSP = "scarthgap"
```

## Task1- Demo App Recipe/meta-sample/conf/layer.conf
```bitbake
# We have a conf and classes directory, add to BBPATH
BBPATH .= ":${LAYERDIR}"

# We have recipes-* directories, add to BBFILES
BBFILES += "${LAYERDIR}/recipes-*/*/*.bb \
            ${LAYERDIR}/recipes-*/*/*.bbappend"

BBFILE_COLLECTIONS += "meta-sample"
BBFILE_PATTERN_meta-sample = "^${LAYERDIR}/"
BBFILE_PRIORITY_meta-sample = "6"

LAYERDEPENDS_meta-sample = "core"
LAYERSERIES_COMPAT_meta-sample = "scarthgap"
```

## Task3-Custom-Image/my-layer/conf/layer.conf
```bitbake
BBPATH .= ":${LAYERDIR}"
BBFILES += "${LAYERDIR}/recipes-*/*/*.bb"
BBFILE_COLLECTIONS += "my-layer"
BBFILE_PATTERN_my-layer = "^${LAYERDIR}/"
LAYER_CONF_VERSION = "8"
LAYERSERIES_COMPAT_my-layer = "scarthgap"
```
